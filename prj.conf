## Kconfig
```
#
# Copyright (c) 2020 Nordic Semiconductor ASA
#
# SPDX-License-Identifier: LicenseRef-Nordic-5-Clause
#

menu "MQTT simple sample"

#// Start:GNSS simple import modules/////////////////////////////////////////////////////

# STEP 3.1 - Define configuration for fix interval
config GNSS_PERIODIC_INTERVAL
	int "Fix interval for periodic GPS fixes"
	range 10 65535
	#original is 120 seconds
	default 120
	help
	  Fix interval (in seconds) for periodic fixes.

# STEP 3.2 - Define configuration for fix timeout
config GNSS_PERIODIC_TIMEOUT
	int "Fix timeout for periodic GPS fixes"
	range 0 65535
	default 480
	help
	  Fix timeout (in seconds) for periodic fixes.
	  If set to zero, GNSS is allowed to run indefinitely until a valid PVT estimate is produced.


#// End:GNSS simple import modules//////////////////////////////////////////////////////


config MQTT_PUB_TOPIC
	string "MQTT publish topic"
	default "my/publish/topic"

config MQTT_SUB_TOPIC
	string "MQTT subscribe topic"
	default "my/subscribe/topic"

config MQTT_CLIENT_ID
	string "MQTT Client ID"
	help
	  Use a custom Client ID string. If not set, the client ID will be
	  generated based on IMEI number (for nRF9160 based targets) or
	  randomly (for other platforms).
	default ""

config MQTT_BROKER_HOSTNAME
	string "MQTT broker hostname"
	default "mqtt.eclipseprojects.io"

config MQTT_BROKER_PORT
	int "MQTT broker port"
	default 1883

config MQTT_MESSAGE_BUFFER_SIZE
	int "MQTT message buffer size"
	default 128

config MQTT_PAYLOAD_BUFFER_SIZE
	int "MQTT payload buffer size"
	default 128

config BUTTON_EVENT_PUBLISH_MSG
	string "The message to publish on a button event"
	default "latitude,longitude"

config BUTTON_EVENT_BTN_NUM
	int "The button number"
	default 1

config MQTT_RECONNECT_DELAY_S
	int "Seconds to delay before attempting to reconnect to the broker"
	default 60

config LTE_CONNECT_RETRY_DELAY_S
	int "Seconds to delay before attempting to retry LTE connection"
	default 120

config MQTT_TLS_SEC_TAG
	int "TLS credentials security tag"
	default 24

config MQTT_TLS_SESSION_CACHING
	bool "Enable TLS session caching"

config MQTT_TLS_PEER_VERIFY
	int "Set peer verification level"
	#0 on other mqtt example
	default 2
	help
		Set to 0 for VERIFY_NONE, 1 for VERIFY_OPTIONAL, and 2 for
		VERIFY_REQUIRED.

endmenu

menu "Zephyr Kernel"
source "Kconfig.zephyr"
endmenu

module = MQTT_SIMPLE
module-str = MQTT Simple
source "${ZEPHYR_BASE}/subsys/logging/Kconfig.template.log_config"
```

## prj.conf
```kconfig
#
# Copyright (c) 2020 Nordic Semiconductor ASA
#
# SPDX-License-Identifier: LicenseRef-Nordic-5-Clause
#

# Networking
CONFIG_NETWORKING=y
CONFIG_NET_NATIVE=n
CONFIG_NET_SOCKETS_OFFLOAD=y
CONFIG_NET_SOCKETS=y
CONFIG_NET_SOCKETS_POSIX_NAMES=y

# LTE link control
CONFIG_LTE_LINK_CONTROL=y
CONFIG_LTE_AUTO_INIT_AND_CONNECT=n

#// Start:GNSS simple import modules/////////////////////////////////////////////////////
# added to mqtt sample, might cause problems
CONFIG_LTE_NETWORK_MODE_LTE_M_NBIOT_GPS=y
#// End:GNSS simple import modules//////////////////////////////////////////////////////


# Modem library
CONFIG_NRF_MODEM_LIB=y

# MQTT
CONFIG_MQTT_LIB=y
CONFIG_MQTT_LIB_TLS=n
CONFIG_MQTT_CLEAN_SESSION=y

# Application
CONFIG_MQTT_PUB_TOPIC="ESETCOORDINATES"
CONFIG_MQTT_SUB_TOPIC="ESETCOORDINATES"
# CONFIG_MQTT_CLIENT_ID="my-client-id"
CONFIG_MQTT_BROKER_HOSTNAME="broker.emqx.io"
# CONFIG_MQTT_BROKER_PORT=1883

# Button support
CONFIG_DK_LIBRARY=y

# Enable logging
CONFIG_LOG=y
CONFIG_MQTT_SIMPLE_LOG_LEVEL_DBG=y

# Memory
CONFIG_MAIN_STACK_SIZE=4096 
#does not match gnss sample (2048 is for mqtt)
CONFIG_HEAP_MEM_POOL_SIZE=4096


# NewLib C
CONFIG_NEWLIB_LIBC=y

#// Start:GNSS simple import modules/////////////////////////////////////////////////////

# STEP 2.2 - Enable printing of floating-points / GNSS simple
# added to mqtt sample
CONFIG_NEWLIB_LIBC_FLOAT_PRINTF=y
# added to mqtt sample
CONFIG_FPU=y

#// End:GNSS simple import modules//////////////////////////////////////////////////////
```

## src/coordinates.c
```c
#include "coordinates.h"
float latCoord = 0.0;
float lonCoord = 0.0;
```

## src/coordinates.h
```c
extern float latCoord;
extern float lonCoord;
```
